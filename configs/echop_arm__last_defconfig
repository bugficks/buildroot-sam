## package/ntpclient/Config.in
```kconfig
config BR2_PACKAGE_NTPCLIENT
 bool "ntpclient" 
 default y if !BR2_arm_no_samsung
 help 

  http://doolittle.icarus.com/ntpclient/
```

## package/openssh/Config.in
```kconfig
config BR2_PACKAGE_OPENSSH
	bool "openssh"
	depends on BR2_USE_MMU # fork()
	select BR2_PACKAGE_OPENSSL
	select BR2_PACKAGE_ZLIB
	default y if !BR2_arm_no_samsung
	help
	  A free version of the SSH protocol suite of network connectivity
	  tools.  The standard 'ssh', 'sshd', 'scp', and friends.

	  http://www.openssh.com/
```
